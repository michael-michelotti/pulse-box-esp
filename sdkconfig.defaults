## sdkconfig.defaults
```kconfig
# WiFi
CONFIG_ESP_WIFI_MODE_STA=y

# FreeRTOS
CONFIG_FREERTOS_HZ=1000

# LWIP - increase UDP receive buffer
CONFIG_LWIP_UDP_RECVMBOX_SIZE=32

# LED Strip (RMT)
CONFIG_RMT_ISR_IRAM_SAFE=y

# Console UART
CONFIG_ESP_CONSOLE_UART_NUM=0
CONFIG_ESP_CONSOLE_UART_BAUDRATE=115200

# Partition table
CONFIG_PARTITION_TABLE_SINGLE_APP=y

# Stack sizes for tasks
CONFIG_ESP_MAIN_TASK_STACK_SIZE=8192

# Pin WiFi and lwIP tasking to core 1, separate from core render task
CONFIG_ESP_WIFI_TASK_CORE_ID=1
CONFIG_LWIP_TCPIP_TASK_CORE_ID=1
```
